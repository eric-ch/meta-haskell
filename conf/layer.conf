## conf/layer.conf
```bitbake
# We have a conf and classes directory, append to BBPATH
BBPATH .= ":${LAYERDIR}"

# We have a recipes directory, add to BBFILES
BBFILES += " \
    ${LAYERDIR}/recipes-*/*/*.bb \
    ${LAYERDIR}/recipes-*/*/*.bbappend \
    ${LAYERDIR}/recipes-*/*/*/*.bb \
    ${LAYERDIR}/recipes-*/*/*/*.bbappend \
    ${LAYERDIR}/recipes-*/*/*/*/*.bb \
    ${LAYERDIR}/recipes-*/*/*/*/*.bbappend \
"

BBFILE_COLLECTIONS += "meta-haskell"
BBFILE_PATTERN_meta-haskell := "^${LAYERDIR}/"
BBFILE_PRIORITY_meta-haskell = "9"

LICENSE_PATH += " ${LAYERDIR}/licenses/"

LAYERVERSION_meta-haskell = "1"
```
